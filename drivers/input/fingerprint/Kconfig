## drivers/input/fingerprint/Kconfig
```kconfig
# SPDX-License-Identifier: GPL-2.0-only
#
# Fingerprint driver configuration
#

config GOODIX_FINGERPRINT
	tristate "generic goodix fingerprint driver"
	default n
	help
	  add support for goodix fingerprint driver.
```

## drivers/input/touchscreen/Kconfig
```kconfig
# SPDX-License-Identifier: GPL-2.0-only
#
# Input misc drivers configuration
#

config TOUCHSCREEN_CAP1296
        tristate "touch driver for cap1296"
        help
          The CAP1296 is a multiple channel capacitive touch
          sensor controller. It contains six (6) individual capaci-
          tive touch sensor inputs with programmable sensitivity
          for use in touch sensor applications.

config TOUCHSCREEN_NOTHING
        tristate "Focaltech Touchscreen"
        default n
        help
          Say Y here if you have Focaltech touch panel.
          If unsure, say N.
```

## drivers/nothing_stability/Kconfig
```kconfig
config NOTHING_WRITRBACK_KMSG
	tristate "Nothing boot/panic kmsg writeback to logdump"
	default n
	help
	  Writes a rolling copy of the kernel log to the logdump partition
	  throughout boot (ported from Nothing's stock 5.4 nothing_stability
	  driver). Doesn't log any customer info. When the device is stuck,
	  this can help debug it: the partition can be read back with
	  dd on a later, working boot (adb root required), independent of
	  USB/display state during the stuck boot itself.
```
