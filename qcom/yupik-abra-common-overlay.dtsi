// SPDX-License-Identifier: BSD-3-Clause
/*
 * Copyright (c) Qualcomm Technologies, Inc. and/or its subsidiaries.
 *
 * Nothing board overlay, ported from the 5.4-era yupik-abra-common-overlay.dtsi.
 * The ramoops override is adapted for 6.12: ramoops_mem becomes a static
 * "ramoops" node (see the spacewar overlay) and the unused dynamic
 * /soc/qcom_ramoops node is disabled.
 */

/* Reserved for bootloader log memory according to xbl uefiplat.cfg */
&soc {
	bootloader_log {
		compatible = "nothing,bootloader_log";
		memory-region = <&reserved_xbl_uefi>;
		log,offset_size = <0x4000 0x100000>;
	};
};

/* Dynamic qcom,ramoops driver is off; ramoops_mem is a static node (see spacewar overlay). */
&{/soc/qcom_ramoops} {
	status = "disabled";
};
